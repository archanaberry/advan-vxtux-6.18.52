## 6.18.52-VXTux-UMS512/drivers/Kconfig
```kconfig
# SPDX-License-Identifier: GPL-2.0
menu "Device Drivers"

# Keep I/O buses first

source "drivers/amba/Kconfig"
source "drivers/eisa/Kconfig"
source "drivers/pci/Kconfig"
source "drivers/cxl/Kconfig"
# source "drivers/pcmcia/Kconfig"  # Removed: legacy PCMCIA support
source "drivers/rapidio/Kconfig"

config PC104
	bool "PC/104 support" if EXPERT
	help
	  Expose PC/104 form factor device drivers and options available for
	  selection and configuration. Enable this option if your target
	  machine has a PC/104 bus.

source "drivers/base/Kconfig"

source "drivers/bus/Kconfig"

source "drivers/cache/Kconfig"

source "drivers/connector/Kconfig"

source "drivers/firmware/Kconfig"

source "drivers/fwctl/Kconfig"

source "drivers/gnss/Kconfig"

source "drivers/mtd/Kconfig"

source "drivers/of/Kconfig"

source "drivers/parport/Kconfig"

source "drivers/pnp/Kconfig"

source "drivers/block/Kconfig"

source "drivers/nvme/Kconfig"

source "drivers/misc/Kconfig"

source "drivers/scsi/Kconfig"

source "drivers/ata/Kconfig"

source "drivers/md/Kconfig"

source "drivers/target/Kconfig"

source "drivers/message/fusion/Kconfig"

source "drivers/firewire/Kconfig"


source "drivers/net/Kconfig"

source "drivers/isdn/Kconfig"

# input before char - char/joystick depends on it. As does USB.

source "drivers/input/Kconfig"

source "drivers/char/Kconfig"

source "drivers/i2c/Kconfig"

source "drivers/i3c/Kconfig"

source "drivers/spi/Kconfig"

source "drivers/spmi/Kconfig"

source "drivers/hsi/Kconfig"

source "drivers/pps/Kconfig"

source "drivers/ptp/Kconfig"

source "drivers/dpll/Kconfig"

source "drivers/pinctrl/Kconfig"

source "drivers/gpio/Kconfig"

source "drivers/w1/Kconfig"

source "drivers/power/Kconfig"

source "drivers/hwmon/Kconfig"

source "drivers/thermal/Kconfig"

source "drivers/watchdog/Kconfig"

source "drivers/ssb/Kconfig"

source "drivers/bcma/Kconfig"

source "drivers/mfd/Kconfig"

source "drivers/regulator/Kconfig"

source "drivers/media/Kconfig"

source "drivers/video/Kconfig"

source "drivers/accel/Kconfig"

source "sound/Kconfig"

source "drivers/hid/Kconfig"

source "drivers/usb/Kconfig"

source "drivers/mmc/Kconfig"

source "drivers/ufs/Kconfig"

source "drivers/memstick/Kconfig"

source "drivers/leds/Kconfig"

source "drivers/accessibility/Kconfig"

source "drivers/infiniband/Kconfig"

source "drivers/edac/Kconfig"

source "drivers/rtc/Kconfig"

source "drivers/dma/Kconfig"

source "drivers/dma-buf/Kconfig"

source "drivers/dca/Kconfig"

source "drivers/uio/Kconfig"

source "drivers/vfio/Kconfig"
source "drivers/virtio/Kconfig"
source "drivers/vdpa/Kconfig"
source "drivers/comedi/Kconfig"

source "drivers/staging/Kconfig"

source "drivers/platform/Kconfig"

source "drivers/clk/Kconfig"

source "drivers/hwspinlock/Kconfig"

source "drivers/clocksource/Kconfig"

source "drivers/mailbox/Kconfig"

source "drivers/iommu/Kconfig"

source "drivers/remoteproc/Kconfig"

source "drivers/rpmsg/Kconfig"

source "drivers/soundwire/Kconfig"

source "drivers/soc/Kconfig"
source "drivers/soc/sprd/Kconfig"
source "drivers/sound/soc/sprd/Kconfig"
source "drivers/gpu/drm/sprd/Kconfig"
source "drivers/media/platform/sprd/Kconfig"
source "drivers/net/wireless/sprd/Kconfig"
source "drivers/soc/sprd/sipc/Kconfig"
source "drivers/iio/sprd/Kconfig"
source "drivers/thermal/sprd/Kconfig"
source "drivers/input/touchscreen/sprd/Kconfig"
source "drivers/tee/sprd/Kconfig"
source "drivers/usb/typec/sprd/Kconfig"
source "drivers/usb/gadget/function/sprd/Kconfig"
source "drivers/misc/sprd/Kconfig"
source "drivers/memory/sprd/Kconfig"

source "drivers/xen/Kconfig"

source "drivers/pmdomain/Kconfig"

source "drivers/devfreq/Kconfig"

source "drivers/extcon/Kconfig"

source "drivers/memory/Kconfig"

source "drivers/iio/Kconfig"

source "drivers/ntb/Kconfig"

source "drivers/pwm/Kconfig"

source "drivers/irqchip/Kconfig"

source "drivers/ipack/Kconfig"

source "drivers/reset/Kconfig"

source "drivers/phy/Kconfig"

source "drivers/powercap/Kconfig"

source "drivers/mcb/Kconfig"

source "drivers/perf/Kconfig"

source "drivers/ras/Kconfig"


source "drivers/android/Kconfig"

source "drivers/nvdimm/Kconfig"

source "drivers/dax/Kconfig"

source "drivers/nvmem/Kconfig"

source "drivers/hwtracing/Kconfig"

source "drivers/fpga/Kconfig"

source "drivers/fsi/Kconfig"

source "drivers/tee/Kconfig"

source "drivers/trusty/Kconfig"

source "drivers/mux/Kconfig"

source "drivers/opp/Kconfig"

source "drivers/siox/Kconfig"

source "drivers/slimbus/Kconfig"

source "drivers/interconnect/Kconfig"

source "drivers/counter/Kconfig"

source "drivers/most/Kconfig"



source "drivers/cdx/Kconfig"

endmenu

config SPRD_FLASH_DRV
	bool "Spreadtrum camera flash HAL"
	help
	  Registration HAL between the V4L2 flash subdevice and per-chip flash
	  drivers. Ports the vendor sprd_flash_drv.ko; the register/dispatch
	  contract was recovered from that module with radare2 (no source exists
	  in the donors). Chip drivers call sprd_flash_register() to publish
	  themselves; the subdevice calls sprd_flash_ctrl()/sprd_flash_cfg().
	  Registers a misc device "sprd_flash" and creates its own platform
	  device, so it needs no DT node.
```

## 6.18.52-VXTux-UMS512/drivers/clk/Kconfig
```kconfig
# SPDX-License-Identifier: GPL-2.0

config HAVE_CLK
	bool
	help
	  The <linux/clk.h> calls support software clock gating and
	  thus are a key power management tool on many systems.

config HAVE_CLK_PREPARE
	bool

config HAVE_LEGACY_CLK # TODO: Remove once all legacy users are migrated
	bool
	select HAVE_CLK
	help
	  Select this option when the clock API in <linux/clk.h> is implemented
	  by platform/architecture code. This method is deprecated. Modern
	  code should select COMMON_CLK instead and not define a custom
	  'struct clk'.

menuconfig COMMON_CLK
	bool "Common Clock Framework"
	depends on !HAVE_LEGACY_CLK
	select HAVE_CLK_PREPARE
	select HAVE_CLK
	select RATIONAL
	help
	  The common clock framework is a single definition of struct
	  clk, useful across many platforms, as well as an
	  implementation of the clock API in include/linux/clk.h.
	  Architectures utilizing the common struct clk should select
	  this option.

if COMMON_CLK

config COMMON_CLK_WM831X
	tristate "Clock driver for WM831x/2x PMICs"
	depends on MFD_WM831X
	help
	  Supports the clocking subsystem of the WM831x/2x series of
	  PMICs from Wolfson Microelectronics.

source "drivers/clk/versatile/Kconfig"

config COMMON_CLK_SCMI
	tristate "Clock driver controlled via SCMI interface"
	depends on ARM_SCMI_PROTOCOL || COMPILE_TEST
	help
	  This driver provides support for clocks that are controlled
	  by firmware that implements the SCMI interface.

	  This driver uses SCMI Message Protocol to interact with the
	  firmware providing all the clock controls.

config COMMON_CLK_SCPI
	tristate "Clock driver controlled via SCPI interface"
	depends on ARM_SCPI_PROTOCOL || COMPILE_TEST
	help
	  This driver provides support for clocks that are controlled
	  by firmware that implements the SCPI interface.

	  This driver uses SCPI Message Protocol to interact with the
	  firmware providing all the clock controls.

config COMMON_CLK_PWM
	tristate "Clock driver for PWMs used as clock outputs"
	depends on PWM
	help
	  Adapter driver so that any PWM output can be (mis)used as clock signal
	  at 50% duty cycle.

config COMMON_CLK_FIXED_MMIO
	bool "Clock driver for Memory Mapped Fixed values"
	depends on COMMON_CLK && OF
	depends on HAS_IOMEM
	help
	  Support for Memory Mapped IO Fixed clocks

source "drivers/clk/actions/Kconfig"
source "drivers/clk/analogbits/Kconfig"
source "drivers/clk/baikal-t1/Kconfig"
source "drivers/clk/bcm/Kconfig"
source "drivers/clk/hisilicon/Kconfig"
source "drivers/clk/imgtec/Kconfig"
source "drivers/clk/imx/Kconfig"
source "drivers/clk/ingenic/Kconfig"
source "drivers/clk/keystone/Kconfig"
source "drivers/clk/mediatek/Kconfig"
source "drivers/clk/mmp/Kconfig"
source "drivers/clk/meson/Kconfig"
source "drivers/clk/mstar/Kconfig"
source "drivers/clk/microchip/Kconfig"
source "drivers/clk/mvebu/Kconfig"
source "drivers/clk/nuvoton/Kconfig"
source "drivers/clk/pistachio/Kconfig"
source "drivers/clk/qcom/Kconfig"
source "drivers/clk/ralink/Kconfig"
source "drivers/clk/renesas/Kconfig"
source "drivers/clk/rockchip/Kconfig"
source "drivers/clk/samsung/Kconfig"
source "drivers/clk/sifive/Kconfig"
source "drivers/clk/socfpga/Kconfig"
source "drivers/clk/sophgo/Kconfig"
source "drivers/clk/spacemit/Kconfig"
source "drivers/clk/sprd/Kconfig"
source "drivers/clk/starfive/Kconfig"
source "drivers/clk/sunxi/Kconfig"
source "drivers/clk/sunxi-ng/Kconfig"
source "drivers/clk/tegra/Kconfig"
source "drivers/clk/thead/Kconfig"
source "drivers/clk/stm32/Kconfig"
source "drivers/clk/ti/Kconfig"
source "drivers/clk/uniphier/Kconfig"
source "drivers/clk/visconti/Kconfig"
source "drivers/clk/x86/Kconfig"
source "drivers/clk/xilinx/Kconfig"
source "drivers/clk/zynqmp/Kconfig"

# Kunit test cases
config CLK_KUNIT_TEST
	tristate "Basic Clock Framework Kunit Tests" if !KUNIT_ALL_TESTS
	depends on KUNIT
	default KUNIT_ALL_TESTS
	select DTC
	help
	  Kunit tests for the common clock framework.

config CLK_FIXED_RATE_KUNIT_TEST
	tristate "Basic fixed rate clk type KUnit test" if !KUNIT_ALL_TESTS
	depends on KUNIT
	default KUNIT_ALL_TESTS
	select DTC
	help
	  KUnit tests for the basic fixed rate clk type.

config CLK_GATE_KUNIT_TEST
	tristate "Basic gate type Kunit test" if !KUNIT_ALL_TESTS
	depends on KUNIT
	depends on !S390
	default KUNIT_ALL_TESTS
	help
	  Kunit test for the basic clk gate type.

config CLK_FD_KUNIT_TEST
	tristate "Basic fractional divider type Kunit test" if !KUNIT_ALL_TESTS
	depends on KUNIT
	default KUNIT_ALL_TESTS
	help
	  Kunit test for the clk-fractional-divider type.

endif
```

## 6.18.52-VXTux-UMS512/drivers/devfreq/sprd/Kconfig
```kconfig
# SPDX-License-Identifier: GPL-2.0
config SPRD_TOP_DVFS
	tristate "Unisoc TOP DVFS devfreq driver"
	depends on PM_DEVFREQ && COMMON_CLK
	help
	  Hardware DVFS for the Unisoc T618 (UMS512) TOP domain. Replaces the
	  sprd-top-dvfs vendor blob.

config SPRD_APSYS_DVFS
	tristate "Unisoc apsys hardware DVFS driver"
	depends on PM_DEVFREQ
	help
	  Hardware DVFS gating for the Unisoc apsys blocks. One driver covering
	  three vendor blobs: apsys-dvfs, sprd_cp_dvfs and sprd_ddr_dvfs.
```

## 6.18.52-VXTux-UMS512/drivers/dma-buf/sprd/Kconfig
```kconfig
# SPDX-License-Identifier: GPL-2.0-only
#
# Unisoc (SPRD) dma-buf / ION pieces.

config SPRD_ION
	tristate "Unisoc ION allocator"
	help
	  Vendor ION allocator for Unisoc UMS512/T618 (sprd_ion.c). Provides
	  sprd_ion_get_buffer() / sprd_ion_get_phys_addr() / sprd_ion_free_buffer()
	  used by the VSP (vsp_common.c), CPP (cpp_core.c) and JPG (sprd_jpg)
	  drivers -- all three `select SPRD_ION`.

	  DECLARED 2026-10-09: before this the symbol had NO definition in any
	  Kconfig, so `select SPRD_ION` from the consumers selected an implicit
	  symbol that olddefconfig/syncconfig silently DROPS from .config
	  (undeclared symbols are not written to auto.conf), and the Makefile's
	  obj-$(CONFIG_SPRD_ION) then built nothing. Symptom on the device
	  build: ion built only while a hand-appended CONFIG_SPRD_ION=y survived
	  in .config; every kconfig pass removed it and sprd_ion.o stopped
	  building, leaving the consumers with unresolved symbols.

	  Say M to build the module, or Y to link it into the kernel.

config ION_IPC_TRUSTY
	tristate "Unisoc ION <-> Trusty IPC client"
	depends on TRUSTY_VIRTIO_IPC
	help
	  Transport adapter between the Unisoc ION allocator and the Trusty TEE.
	  Ports the vendor blob ion_ipc_trusty.ko: it opens the TIPC channel
	  "com.android.trusty.ion" and forwards ION messages to the secure world.

	  This module is a pure CLIENT of the tipc_chan_* API. It provides no
	  ION allocation itself and needs no ION core, so it is independent of
	  CONFIG_SPRD_ION (declared in this file since 2026-10-09; before that
	  it had no definition, and ION itself was removed from mainline).

	  The protocol was recovered from the vendor blob with radare2 and
	  Ghidra; see drivers/dma-buf/sprd/ion_ipc_trusty.c for the provenance
	  and for the three deliberate deviations from the blob.

	  Say M to build the module (recommended while it is unproven at
	  runtime), or Y to link it into the kernel. Say N if unsure.
```

## 6.18.52-VXTux-UMS512/drivers/gpu/drm/sprd/gsp/Kconfig
```kconfig
config DRM_SPRD_GSP
	tristate "SPRD DRM GSP driver"
	depends on ARCH_SPRD
	depends on DRM_SPRD
	depends on SPRD_IOMMU
	help
	  GSP is hardware which not only can compose multiple layers
	  but also can transform and scale layers.

	  The T618 is a "pike2" part and binds to the
	  "sprd,gsp-lite_r2p0-pike2" compatible string, which selects
	  the gsp_lite_r2p0 core.

	  Note: the gsp_layer buffer path calls the Unisoc ION helper
	  sprd_ion_is_reserved(). ION was dropped from mainline and no
	  provider for that symbol exists in this tree or in any donor, so
	  gsp_ion_stub.c supplies it as a documented shim that always reports
	  "not reserved", which puts the caller on the IOVA path. The other
	  helper gsp_layer.c calls, sprd_ion_get_phys_addr(), comes from the
	  real ported driver in drivers/dma-buf/sprd/ and is deliberately not
	  duplicated here. The module links, loads and probes; a layer whose
	  buffer really is a reserved ION carveout will take the IOVA path,
	  which is a functional limitation rather than a memory-safety one.

config DRM_SPRD_GSP_IPC_TRUSTY
	bool "SPRD DRM GSP widevine driver"
	depends on DRM_SPRD_GSP
	depends on TRUSTY_VIRTIO_IPC
	help
	  This function is to support the widevine function.

config DRM_SPRD_GSP_DVFS
	bool "SPRD DRM GSP dvfs driver"
	depends on DRM_SPRD_GSP
	depends on SPRD_APSYS_DVFS
	help
	  This function is to support the dvfs function.
```

## 6.18.52-VXTux-UMS512/drivers/gpu/drm/sprd/sprd_panel_vxtux/Kconfig
```kconfig
# SPDX-License-Identifier: GPL-2.0
config DRM_PANEL_VXTUX_UMS512
	tristate "VXTux generic MIPI-DSI panel (UMS512 1200x2000)"
	depends on DRM && DRM_MIPI_DSI && OF
	help
	  Generic MIPI-DSI panel for UMS512 tablet (Advan Tab VX Lite T1030).
	  Completes pure DRM/KMS path: DPU (CRTC/plane) -> DSI host -> panel
	  (connector). Default mode 1200x2000; vendor timings/init-sequence
	  pending from stock DT (see docs/drm_kms_map.md).
```

## 6.18.52-VXTux-UMS512/drivers/hwtracing/Kconfig
```kconfig
# SPDX-License-Identifier: GPL-2.0-only
menu "HW tracing support"

source "drivers/hwtracing/stm/Kconfig"



endmenu
```
