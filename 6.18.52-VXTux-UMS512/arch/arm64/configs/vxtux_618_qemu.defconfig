## 6.18.52-VXTux-UMS512/drivers/i2c/busses/Kconfig
```kconfig
# SPDX-License-Identifier: GPL-2.0-only
#
# Sensor device configuration
#

menu "I2C Hardware Bus support"
	depends on HAS_IOMEM

comment "I2C system bus drivers (mostly embedded / system-on-chip)"

config I2C_DESIGNWARE_CORE
	tristate "Synopsys DesignWare I2C adapter"
	select REGMAP
	help
	  This option enables support for the Synopsys DesignWare I2C adapter.
	  This driver includes support for the I2C host on the Synopsys
	  Designware I2C adapter.

	  To compile the driver as a module, choose M here: the module will be
	  called i2c-designware-core.

if I2C_DESIGNWARE_CORE

config I2C_DESIGNWARE_SLAVE
	bool "Synopsys DesignWare Slave"
	select I2C_SLAVE
	help
	  If you say yes to this option, support will be included for the
	  Synopsys DesignWare I2C slave adapter.

config I2C_DESIGNWARE_PLATFORM
	tristate "Synopsys DesignWare Platform driver"
	depends on (ACPI && COMMON_CLK) || !ACPI
	select MFD_SYSCON if MIPS_BAIKAL_T1
	default I2C_DESIGNWARE_CORE
	help
	  If you say yes to this option, support will be included for the
	  Synopsys DesignWare I2C adapters on the platform bus.

	  This driver can also be built as a module.  If so, the module
	  will be called i2c-designware-platform.

config I2C_DESIGNWARE_AMDISP
	tristate "Synopsys DesignWare Platform for AMDISP"
	depends on DRM_AMD_ISP || COMPILE_TEST
	depends on I2C_DESIGNWARE_CORE
	help
	  If you say yes to this option, support will be included for the
	  AMDISP Synopsys DesignWare I2C adapter.

	  This driver can also be built as a module.  If so, the module
	  will be called amd_isp_i2c_designware.

config I2C_DESIGNWARE_AMDPSP
	bool "AMD PSP I2C semaphore support"
	depends on ACPI
	depends on CRYPTO_DEV_SP_PSP
	depends on PCI
	depends on I2C_DESIGNWARE_PLATFORM
	depends on (I2C_DESIGNWARE_PLATFORM=y && CRYPTO_DEV_CCP_DD=y) || \
		   (I2C_DESIGNWARE_PLATFORM=m && CRYPTO_DEV_CCP_DD)
	help
	  This driver enables managed host access to the selected I2C bus shared
	  between AMD CPU and AMD PSP.

	  You should say Y if running on an AMD system equipped with the PSP.

config I2C_DESIGNWARE_BAYTRAIL
	bool "Intel Baytrail I2C semaphore support"
	depends on ACPI
	depends on I2C_DESIGNWARE_PLATFORM
	depends on (I2C_DESIGNWARE_PLATFORM=m && IOSF_MBI) || \
		   (I2C_DESIGNWARE_PLATFORM=y && IOSF_MBI=y)
	help
	  This driver enables managed host access to the PMIC I2C bus on select
	  Intel BayTrail platforms using the X-Powers AXP288 PMIC. It allows
	  the host to request uninterrupted access to the PMIC's I2C bus from
	  the platform firmware controlling it. You should say Y if running on
	  a BayTrail system using the AXP288.

config I2C_DESIGNWARE_PCI
	tristate "Synopsys DesignWare PCI driver"
	depends on PCI
	help
	  If you say yes to this option, support will be included for the
	  Synopsys DesignWare I2C adapters on the PCI bus. Only master mode is
	  supported.

	  This driver can also be built as a module.  If so, the module
	  will be called i2c-designware-pci.

endif

config I2C_GPIO
	tristate "GPIO-based bitbanging I2C"
	depends on GPIOLIB || COMPILE_TEST
	select I2C_ALGOBIT
	help
	  This is a very simple bitbanging I2C driver utilizing the
	  arch-neutral GPIO API to control the SCL and SDA lines.

config I2C_GPIO_FAULT_INJECTOR
	bool "GPIO-based fault injector"
	depends on I2C_GPIO
	help
	  This adds some functionality to the i2c-gpio driver which can inject
	  faults to an I2C bus, so another bus master can be stress-tested.
	  This is for debugging. If unsure, say 'no'.

config I2C_CBUS_GPIO
	tristate "CBUS I2C driver"
	depends on GPIOLIB || COMPILE_TEST
	help
	  Support for CBUS access using I2C API. Mostly relevant for Nokia
	  Internet Tablets (770, N800 and N810).

	  This driver can also be built as a module.  If so, the module
	  will be called i2c-cbus-gpio.

config I2C_SPRD
	tristate "Spreadtrum I2C interface"
	depends on I2C=y && (ARCH_SPRD || COMPILE_TEST)
	depends on COMMON_CLK
	help
	  If you say yes to this option, support will be included for the
	  Spreadtrum I2C interface.

config I2C_VERSATILE
	tristate "ARM Versatile/Realview I2C bus support"
	depends on ARCH_MPS2 || ARCH_VERSATILE || ARCH_REALVIEW || ARCH_VEXPRESS || COMPILE_TEST
	select I2C_ALGOBIT
	help
	  Say yes if you want to support the I2C serial bus on ARMs Versatile
	  range of platforms.

	  This driver can also be built as a module.  If so, the module
	  will be called i2c-versatile.

config I2C_MPC
	tristate "MPC107/824x/85xx/512x/52xx/83xx/86xx"
	depends on PPC
	help
	  If you say yes to this option, support will be included for the
	  built-in I2C interface on the MPC107, Tsi107, MPC512x, MPC52xx,
	  MPC8240, MPC8245, MPC83xx, MPC85xx and MPC8641 family processors.

	  This driver can also be built as a module.  If so, the module
	  will be called i2c-mpc.

if ACPI

config I2C_SCMI
	tristate "SMBus Control Method Interface"
	help
	  This driver supports the SMBus Control Method Interface. It needs the
	  BIOS to declare ACPI control methods as described in the SMBus Control
	  Method Interface specification.

	  To compile this driver as a module, choose M here:
	  the module will be called i2c-scmi.

endif # ACPI

config I2C_VIRTIO
	tristate "Virtio I2C Adapter"
	select VIRTIO
	help
	  If you say yes to this option, support will be included for the virtio
	  I2C adapter driver. The hardware can be emulated by any device model
	  software according to the virtio protocol.

	  This driver can also be built as a module. If so, the module
	  will be called i2c-virtio.

endmenu
```

## 6.18.52-VXTux-UMS512/drivers/media/platform/sprd/sensors/Kconfig
```kconfig
# SPDX-License-Identifier: GPL-2.0

config VIDEO_GC8034
	tristate "GalaxyCore GC8034 8MP sensor support (VXTux)"
	depends on I2C && VIDEO_V4L2_SUBDEV_API
	select V4L2_CCI_I2C
	help
	  Driver for GalaxyCore GC8034 8MP CMOS image sensor.
	  Used as rear camera on Advan T1030 (UMS512/T618).
	  Supports 3264x2448 resolution, 2-lane CSI-2.

config VIDEO_GC5025
	tristate "GalaxyCore GC5025 5MP sensor support (VXTux)"
	depends on I2C && VIDEO_V4L2_SUBDEV_API
	select V4L2_CCI_I2C
	help
	  Driver for GalaxyCore GC5025 5MP CMOS image sensor.
	  Rockchip-based driver for front/selfie camera.

config VIDEO_S5K4H7YX
	tristate "Samsung S5K4H7YX 8MP sensor support (VXTux)"
	depends on I2C && VIDEO_V4L2_SUBDEV_API
	select V4L2_CCI_I2C
	help
	  Driver for Samsung S5K4H7YX 8MP CMOS image sensor.

config SPRD_SENSOR
	tristate "SPRD camera sensor framework (CSI RX / sensor core)"
	depends on I2C && VIDEO_V4L2_SUBDEV_API
	help
	  Spreadtrum camera sensor framework: the sensor core (misc device +
	  thread), the sensor driver (power/clock/reset sequencing) and the CSI
	  receiver. Ported 2026-10-04 from work/donorcatalog/mods-sprd/
	  sprd/common/camera/sensor/.

	  Without this symbol the directory is never entered by Kbuild -- the
	  same silent-descent trap as drivers/soc/sprd/modem/.
```

## 6.18.52-VXTux-UMS512/drivers/memory/sprd/Kconfig
```kconfig
# SPDX-License-Identifier: GPL-2.0
config VXTUX_HYBRIDSWAP_REF
	tristate "VXTux: hybridswap (OPLUS) reference port (RE)"
	depends on SWAP && ZSMALLOC
	default n
	help
	  OPLUS hybridswap reference port (blob: hyb.o) — additional memory-management feature
	  NOT boot-critical. Blob broken in fork (struct #if conflicts,
	  proven Phase 9B) — this port cleans it up as living documentation.
	  Keep n unless researching UMS512 zram/zswap.
```

## 6.18.52-VXTux-UMS512/drivers/misc/sprd/Kconfig
```kconfig
# SPDX-License-Identifier: GPL-2.0
config SPRD_MAP
	tristate "Unisoc map_user (mmap reserved memory, VXTux port)"
	depends on OF
	help
	  Unisoc map_user misc driver (GPL 5.4 -> 6.18 port). Provides /dev/map_user
	  for mmap reserved memory (faceid-mem) by vendor userspace. ABI ioctl
	  kept identical to blob.
```

## 6.18.52-VXTux-UMS512/drivers/mmc/host/Kconfig
```kconfig
# SPDX-License-Identifier: GPL-2.0-only
#
# MMC/SD host controller drivers
#

comment "MMC/SD/SDIO Host Controller Drivers"

config MMC_DEBUG
	bool "MMC host drivers debugging"
	depends on MMC != n
	help
	  This is an option for use by developers; most people should
	  say N here. This enables MMC host driver debugging. And further
	  added host drivers please don't invent their private macro for
	  debugging.

config MMC_SDHCI
	tristate "Secure Digital Host Controller Interface support"
	depends on HAS_DMA
	help
	  This selects the generic Secure Digital Host Controller Interface.
	  It is used by manufacturers such as Texas Instruments(R), Ricoh(R)
	  and Toshiba(R). Most controllers found in laptops are of this type.

	  If you have a controller with this interface, say Y or M here. You
	  also need to enable an appropriate bus interface.

	  If unsure, say N.

config MMC_SDHCI_IO_ACCESSORS
	bool
	depends on MMC_SDHCI
	help
	  This is silent Kconfig symbol that is selected by the drivers that
	  need to overwrite SDHCI IO memory accessors.

config MMC_SDHCI_BIG_ENDIAN_32BIT_BYTE_SWAPPER
	bool
	depends on MMC_SDHCI
	select MMC_SDHCI_IO_ACCESSORS
	help
	  This option is selected by drivers running on big endian hosts
	  and performing I/O to a SDHCI controller through a bus that
	  implements a hardware byte swapper using a 32-bit datum.
	  This endian mapping mode is called "data invariance" and
	  has the effect of scrambling the addresses and formats of data
	  accessed in sizes other than the datum size.

	  This is the case for the Nintendo Wii SDHCI.

config MMC_SDHCI_UHS2
	tristate "UHS2 support on SDHCI controller" if COMPILE_TEST
	depends on MMC_SDHCI
	help
	  This option is selected by SDHCI controller drivers that want to
	  support UHS2-capable devices.

	  If you have a controller with this feature, say Y or M here.

config MMC_SDHCI_PCI
	tristate "SDHCI support on PCI bus"
	depends on MMC_SDHCI && PCI
	select MMC_CQHCI
	select MMC_SDHCI_UHS2
	select IOSF_MBI if X86
	select MMC_SDHCI_IO_ACCESSORS
	help
	  This selects the PCI Secure Digital Host Controller Interface.
	  Most controllers found today are PCI devices.

	  If you have a controller with this interface, say Y or M here.

	  If unsure, say N.

config MMC_RICOH_MMC
	bool "Ricoh MMC Controller Disabler"
	depends on MMC_SDHCI_PCI
	default y
	help
	  This adds a pci quirk to disable Ricoh MMC Controller. This
	  proprietary controller is unnecessary because the SDHCI driver
	  supports MMC cards on the SD controller, but if it is not
	  disabled, it will steal the MMC cards away - rendering them
	  useless. It is safe to select this even if you don't
	  have a Ricoh based card reader.

	  If unsure, say Y.

config MMC_SDHCI_ACPI
	tristate "SDHCI support for ACPI enumerated SDHCI controllers"
	depends on MMC_SDHCI && ACPI && PCI
	select IOSF_MBI if X86
	help
	  This selects support for ACPI enumerated SDHCI controllers,
	  identified by ACPI Compatibility ID PNP0D40 or specific
	  ACPI Hardware IDs.

	  If you have a controller with this interface, say Y or M here.

	  If unsure, say N.

config MMC_SDHCI_PLTFM
	tristate "SDHCI platform and OF driver helper"
	depends on MMC_SDHCI
	help
	  This selects the common helper functions support for Secure Digital
	  Host Controller Interface based platform and OF drivers.

	  If you have a controller with this interface, say Y or M here.

	  If unsure, say N.

config MMC_SDHCI_OF_ARASAN
	tristate "SDHCI OF support for the Arasan SDHCI controllers"
	depends on MMC_SDHCI_PLTFM
	depends on OF
	depends on COMMON_CLK
	select MMC_CQHCI
	help
	  This selects the Arasan Secure Digital Host Controller Interface
	  (SDHCI). This hardware is found e.g. in Xilinx' Zynq SoC.

	  If you have a controller with this interface, say Y or M here.

	  If unsure, say N.

config MMC_SDHCI_OF_ESDHC
	tristate "SDHCI OF support for the Freescale eSDHC controller"
	depends on MMC_SDHCI_PLTFM
	depends on PPC || ARCH_MXC || ARCH_LAYERSCAPE || COMPILE_TEST
	select MMC_SDHCI_IO_ACCESSORS
	select FSL_GUTS
	help
	  This selects the Freescale eSDHC controller support.

	  If you have a controller with this interface, say Y or M here.

	  If unsure, say N.

config MMC_SDHCI_OF_DWCMSHC
	tristate "SDHCI OF support for the Synopsys DWC MSHC"
	depends on MMC_SDHCI_PLTFM
	depends on OF
	depends on COMMON_CLK
	select MMC_CQHCI
	help
	  This selects Synopsys DesignWare Cores Mobile Storage Controller
	  support.
	  If you have a controller with this interface, say Y or M here.
	  If unsure, say N.

config MMC_SDHCI_SPRD
	tristate "Spreadtrum SDIO host Controller"
	depends on ARCH_SPRD || COMPILE_TEST
	depends on MMC_SDHCI_PLTFM
	select MMC_SDHCI_IO_ACCESSORS
	select MMC_HSQ
	help
	  This selects the SDIO Host Controller in Spreadtrum
	  SoCs, this driver supports R11(IP version: R11P0).

	  If you have a controller with this interface, say Y or M here.

	  If unsure, say N.

config MMC_SDHCI_EXTERNAL_DMA
	bool

config MMC_CQHCI
	tristate "Command Queue Host Controller Interface support"
	depends on HAS_DMA
	help
	  This selects the Command Queue Host Controller Interface (CQHCI)
	  support present in host controllers of Qualcomm Technologies, Inc
	  amongst others.
	  This controller supports eMMC devices with command queue support.

	  If you have a controller with this interface, say Y or M here.

	  If unsure, say N.

config MMC_HSQ
	tristate "MMC Host Software Queue support"
	help
	  This selects the MMC Host Software Queue support. This may increase
	  performance, if the host controller and its driver supports it.

	  If you have a controller/driver supporting this interface, say Y or M
	  here.

	  If unsure, say N.

config MMC_DW
	tristate "Synopsys DesignWare Memory Card Interface"
	depends on ARC || ARM || ARM64 || MIPS || RISCV || CSKY || COMPILE_TEST
	help
	  This selects support for the Synopsys DesignWare Mobile Storage IP
	  block, this provides host support for SD and MMC interfaces, in both
	  PIO, internal DMA mode and external DMA mode.

config MMC_DW_PLTFM
	tristate "Synopsys Designware MCI Support as platform device"
	depends on MMC_DW
	default y
	help
	  This selects the common helper functions support for Host Controller
	  Interface based platform driver. Please select this option if the IP
	  is present as a platform device. This is the common interface for the
	  Synopsys Designware IP.

	  If you have a controller with this interface, say Y or M here.

	  If unsure, say Y.

config MMC_DW_PCI
	tristate "Synopsys Designware MCI support on PCI bus"
	depends on MMC_DW && PCI
	help
	  This selects the PCI bus for the Synopsys Designware Mobile Storage IP.
	  Select this option if the IP is present on PCI platform.

	  If you have a controller with this interface, say Y or M here.

	  If unsure, say N.

config MMC_SPI
	tristate "MMC/SD/SDIO over SPI"
	depends on SPI_MASTER
	select CRC7
	select CRC_ITU_T
	help
	  Some systems access MMC/SD/SDIO cards using a SPI controller
	  instead of using a "native" MMC/SD/SDIO controller.  This has a
	  disadvantage of being relatively high overhead, but a compensating
	  advantage of working on many systems without dedicated MMC/SD/SDIO
	  controllers.

	  If unsure, or if your system has no SPI master driver, say N.

config MMC_SDHI
	tristate "Renesas SDHI SD/SDIO controller support"
	depends on SUPERH || ARCH_RENESAS || COMPILE_TEST
	depends on (RESET_CONTROLLER && REGULATOR) || !OF
	select MMC_TMIO_CORE
	help
	  This provides support for the SDHI SD/SDIO controller found in
	  Renesas SuperH, ARM and ARM64 based SoCs

config MMC_TMIO_CORE
	tristate

config SPRD_SDHCI
	tristate "Spreadtrum/Unisoc SDHCI Host Controller support"
	depends on ARCH_SPRD || COMPILE_TEST
	depends on MMC_SDHCI_PLTFM
	select MMC_SDHCI_IO_ACCESSORS
	select MMC_HSQ
	help
	  This selects the SDHCI Host Controller in Spreadtrum/Unisoc
	  SoCs. This is a separate driver from MMC_SDHCI_SPRD for newer
	  Unisoc SoCs with standard SDHCI interface.

	  If you have a controller with this interface, say Y or M here.

	  If unsure, say N.
```
