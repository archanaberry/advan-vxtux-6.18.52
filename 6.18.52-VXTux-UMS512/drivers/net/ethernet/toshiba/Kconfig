## 6.18.52-VXTux-UMS512/drivers/net/ethernet/toshiba/Kconfig
```kconfig
# SPDX-License-Identifier: GPL-2.0-only
#
# Toshiba network device configuration
#

config NET_VENDOR_TOSHIBA
	bool "Toshiba devices"
	default y
	depends on PCI && MIPS
	help
	  If you have a network (Ethernet) card belonging to this class, say Y.

	  Note that the answer to this question doesn't directly affect the
	  kernel: saying N will just cause the configurator to skip all
	  the questions about Toshiba cards. If you say Y, you will be asked
	  for your specific card in the following questions.

if NET_VENDOR_TOSHIBA

config TC35815
	tristate "TOSHIBA TC35815 Ethernet support"
	depends on PCI && MIPS
	select PHYLIB

endif # NET_VENDOR_TOSHIBA
```

## 6.18.52-VXTux-UMS512/drivers/net/wireless/sprd/sprdwcn/wlan/Kconfig
```kconfig
# SPDX-License-Identifier: GPL-2.0
#
# drivers/vxtux/net/wireless/sprdwcn/wlan/Kconfig
# Port 6.18: sprd_wlan_combo (SC2355 WiFi) — pengganti blob sprd_wlan_combo.ko
# Sumber: gpl-source/hadenix_ums512_wcn/drivers/wcn/wlan/sc2355/
# Config di fragment: CONFIG_WCN_WLAN=m

config WCN_WLAN
	tristate "Spreadtrum SC2355 WiFi driver"
	depends on WCN_CORE && CFG80211
	default n
	help
	  WiFi driver for Spreadtrum SC2355 (SC2355 SDIO WiFi).
	  Replaces vendor blob sprd_wlan_combo.ko.
	  Sumber: gpl-source/hadenix_ums512_wcn/drivers/wcn/wlan/sc2355/
	  Tergantung pada WCN_CORE untuk bus/transport SDIO.

config WCN_WLAN_SC2355
	tristate "SC2355 specific WiFi support"
	depends on WCN_WLAN
	default y
	help
	  Enable SC2355-specific WiFi functionality.
```

## 6.18.52-VXTux-UMS512/drivers/pci/controller/Kconfig
```kconfig
# SPDX-License-Identifier: GPL-2.0

menu "PCI controller drivers"
	depends on PCI

config PCI_HOST_COMMON
	tristate
	select PCI_ECAM

config PCI_AARDVARK
	tristate "Aardvark PCIe controller"
	depends on (ARCH_MVEBU && ARM64) || COMPILE_TEST
	depends on OF
	depends on PCI_MSI
	select PCI_BRIDGE_EMUL
	select IRQ_MSI_LIB
	help
	 Add support for Aardvark 64bit PCIe Host Controller. This
	 controller is part of the South Bridge of the Marvel Armada
	 3700 SoC.

config PCI_FTPCI100
	bool "Faraday Technology FTPCI100 PCI controller"
	depends on OF
	default ARCH_GEMINI

config PCI_HOST_GENERIC
	tristate "Generic PCI host controller"
	depends on OF
	select PCI_HOST_COMMON
	select IRQ_DOMAIN
	help
	  Say Y here if you want to support a simple generic PCI host
	  controller, such as the one emulated by kvmtool.

source "drivers/pci/controller/cadence/Kconfig"
source "drivers/pci/controller/dwc/Kconfig"
source "drivers/pci/controller/mobiveil/Kconfig"
source "drivers/pci/controller/plda/Kconfig"
endmenu
```

## 6.18.52-VXTux-UMS512/drivers/phy/sprd/Kconfig
```kconfig
# SPDX-License-Identifier: GPL-2.0
#
# PHY drivers untuk Unisoc (Spreadtrum) SoC.

config PHY_SPRD_UMS512_USB2
	tristate "Unisoc UMS512/T618 USB2 HS PHY (VXTux RE port)"
	depends on OF
	depends on REGULATOR
	select USB_PHY
	select MFD_SYSCON
	default n
	help
	  USB2 High-Speed PHY untuk Unisoc UMS512/T618 (sharkl5pro),
	  hasil port ABI dari blob vendor phy-sprd-sharkl5Pro.ko (5.4.210)
	  ke API legacy usb_phy mainline 6.18.

	  Driver ini adalah GERBANG stack USB: MUSB (musb_sprd_vxtux)
	  memanggil devm_usb_get_phy_by_phandle() lewat properti DT
	  "usb-phy" dan tidak akan probe tanpa PHY terdaftar.

	  Node DT yang cocok: "sprd,sharkl5-phy" / "sprd,sharkl5pro-phy"
	  (yaitu /soc/aon/hsphy@323b0000 di FDT stok).
	  Register: AON APB 0x327D0000 + ANLG PHY G2 0x323B0000 lewat
	  dua syscon; peta lengkap di docs/usb_register_map.md.
```

## 6.18.52-VXTux-UMS512/drivers/pinctrl/Kconfig
```kconfig
# SPDX-License-Identifier: GPL-2.0-only
#
# PINCTRL infrastructure and drivers
#

menuconfig PINCTRL
	bool "Pin controllers"

if PINCTRL

config GENERIC_PINCTRL_GROUPS
	bool

config PINMUX
	bool "Support pin multiplexing controllers" if COMPILE_TEST

config GENERIC_PINMUX_FUNCTIONS
	bool
	select PINMUX

config PINCONF
	bool "Support pin configuration controllers" if COMPILE_TEST

config GENERIC_PINCONF
	bool
	select PINCONF

config DEBUG_PINCTRL
	bool "Debug PINCTRL calls"
	depends on DEBUG_KERNEL
	help
	  Say Y here to add some extra checks and diagnostics to PINCTRL calls.

config PINCTRL_LOONGSON2
	tristate "Pinctrl driver for the Loongson-2 SoC"
	depends on OF && (LOONGARCH || COMPILE_TEST)
	select PINMUX
	select GENERIC_PINCONF
	help
	 This selects pin control driver for the Loongson-2 SoC. It
	 provides pin config functions multiplexing.  GPIO pin pull-up,
	 pull-down functions are not supported. Say yes to enable
	 pinctrl for Loongson-2 SoC.

config PINCTRL_LPC18XX
	bool "NXP LPC18XX/43XX SCU pinctrl driver"
	depends on OF && (ARCH_LPC18XX || COMPILE_TEST)
	default ARCH_LPC18XX
	select PINMUX
	select GENERIC_PINCONF
	help
	  Pinctrl driver for NXP LPC18xx/43xx System Control Unit (SCU).

config PINCTRL_SCMI
	tristate "Pinctrl driver using SCMI protocol interface"
	depends on ARM_SCMI_PROTOCOL || COMPILE_TEST
	select PINMUX
	select GENERIC_PINCONF
	help
	  This driver provides support for pinctrl which is controlled
	  by firmware that implements the SCMI interface.
	  It uses SCMI Message Protocol to interact with the
	  firmware providing all the pinctrl controls.

config PINCTRL_SINGLE
	tristate "One-register-per-pin type device tree based pinctrl driver"
	depends on OF
	depends on HAS_IOMEM
	select GENERIC_PINCTRL_GROUPS
	select GENERIC_PINMUX_FUNCTIONS
	select GENERIC_PINCONF
	help
	  This selects the device tree based generic pinctrl driver.

source "drivers/pinctrl/sprd/Kconfig"

endif
```

## 6.18.52-VXTux-UMS512/drivers/pinctrl/sprd/Kconfig
```kconfig
# SPDX-License-Identifier: GPL-2.0-only
#
# Spreadtrum pin control drivers
#

config PINCTRL_SPRD
	tristate
	select PINMUX
	select PINCONF
	select GENERIC_PINCONF
	select GENERIC_PINMUX_FUNCTIONS
	help
	  Say Y here to enable Spreadtrum pinctrl driver

config PINCTRL_SPRD_SC9860
	tristate "Spreadtrum SC9860 pinctrl driver"
	depends on OF
	depends on ARCH_SPRD || COMPILE_TEST
	select PINCTRL_SPRD
	help
	  Say Y here to enable Spreadtrum SC9860 pinctrl driver

config PINCTRL_SPRD_SHARKL5PRO
	tristate "Spreadtrum Sharkl5Pro (UMS512/T618) pinctrl driver"
	depends on OF
	depends on ARCH_SPRD || COMPILE_TEST
	select PINCTRL_SPRD
	help
	  Say Y here to enable the Spreadtrum Sharkl5Pro (UMS512/T618) pin
	  controller: 393 pin, MISC/COMMON offset 0x34/0x434.

	  BUKTI (B45-fix, 2026-09-27): angka-angka itu diambil dari fork GPL
	  T618 dan dicocokkan TIGA arah dengan blob pinctrl-sprd-sharkl5Pro.ko
	  (simbol tabel 0x3d68 byte = 393 x 40 byte; disasm sprd_pinctrl_probe
	  melempar w2=393, w3=0x34, w4=0x434). Driver SC9860 mainline TIDAK
	  bisa dipakai untuk SoC ini: harga konstanta offsetnya 0x20/0x4020 dan
	  of_match-nya "sprd,sc9860-pinctrl". Rincian di kepala
	  pinctrl-sprd-sharkl5pro.c.
```

## 6.18.52-VXTux-UMS512/drivers/regulator/Kconfig
```kconfig
# SPDX-License-Identifier: GPL-2.0-only
menuconfig REGULATOR
	bool "Voltage and Current Regulator Support"
	select LINEAR_RANGES
	help
	  Generic Voltage and Current Regulator support.

	  This framework is designed to provide a generic interface to voltage
	  and current regulators within the Linux kernel. It's intended to
	  provide voltage and current control to client or consumer drivers and
	  also provide status information to user space applications through a
	  sysfs interface.

	  The intention is to allow systems to dynamically control regulator
	  output in order to save power and prolong battery life. This applies
	  to both voltage regulators (where voltage output is controllable) and
	  current sinks (where current output is controllable).

	  This framework safely compiles out if not selected so that client
	  drivers can still be used in systems with no software controllable
	  regulators.

	  If unsure, say no.


if REGULATOR

config REGULATOR_DEBUG
	bool "Regulator debug support"
	help
	  Say yes here to enable debugging support.

config REGULATOR_FIXED_VOLTAGE
	tristate "Fixed voltage regulator support"
	help
	  This driver provides support for fixed voltage regulators,
	  useful for systems which use a combination of software
	  managed regulators and simple non-configurable regulators.

config REGULATOR_VIRTUAL_CONSUMER
	tristate "Virtual regulator consumer support"
	help
	  This driver provides a virtual consumer for the voltage and
	  current regulator API which provides sysfs controls for
	  configuring the supplies requested.  This is mainly useful
	  for test purposes.

	  If unsure, say no.

config REGULATOR_USERSPACE_CONSUMER
	tristate "Userspace regulator consumer support"
	help
	  There are some classes of devices that are controlled entirely
	  from user space. Userspace consumer driver provides ability to
	  control power supplies for such devices.

	  If unsure, say no.

config REGULATOR_NETLINK_EVENTS
	bool "Enable support for receiving regulator events via netlink"
	depends on NET
	help
	  Enabling this option allows the kernel to broadcast regulator events using
	  the netlink mechanism. User-space applications can subscribe to these events
	  for real-time updates on various regulator events.

	  If unsure, say no.

config REGULATOR_GPIO
	tristate "GPIO regulator support"
	depends on GPIOLIB || COMPILE_TEST
	help
	  This driver provides support for regulators that can be
	  controlled via gpios.
	  It is capable of supporting current and voltage regulators
	  and the platform has to provide a mapping of GPIO-states
	  to target volts/amps.

config REGULATOR_PWM
	tristate "PWM voltage regulator"
	depends on PWM
	help
	  This driver supports PWM controlled voltage regulators. PWM
	  duty cycle can increase or decrease the voltage.

config REGULATOR_ARM_SCMI
	tristate "SCMI based regulator driver"
	depends on ARM_SCMI_PROTOCOL && OF
	help
	  This adds the regulator driver support for ARM platforms using SCMI
	  protocol for device voltage management.
	  This driver uses SCMI Message Protocol driver to interact with the
	  firmware providing the device Voltage functionality.

config REGULATOR_SC2731
	tristate "Spreadtrum SC2731 power regulator driver"
	depends on MFD_SC27XX_PMIC || COMPILE_TEST
	help
	  This driver provides support for the voltage regulators on the
	  SC2731 PMIC.

config REGULATOR_SC2730
	tristate "Spreadtrum SC2730 power regulator driver"
	depends on OF
	help
	  The SC2730 PMIC integrates DCDC and LDO regulators, among them
	  DCDC_GPU (rail name dcdc-gpu), which is the supply the Mali-G52
	  "Gondul" GPU in the Unisoc UMS512/T618 runs on. Unlike SC2731 this
	  chip names its rails dcdc-* / ldo-*.

	  This driver is backported from mainline (added by Otto Pflüger,
	  linux 6.20) because the 6.18 base this tree uses predates it, and
	  without it no SC2730 rail is registered at all.

config REGULATOR_VCTRL
	tristate "Virtual regulator control support"
	help
	  This driver provides support for virtual regulator control.

endif
```

## 6.18.52-VXTux-UMS512/drivers/remoteproc/Kconfig
```kconfig
# SPDX-License-Identifier: GPL-2.0-only
menu "Remoteproc drivers"

config REMOTEPROC
	bool "Support for Remote Processor subsystem"
	depends on HAS_DMA
	select CRC32
	select FW_LOADER
	select VIRTIO
	select WANT_DEV_COREDUMP
	help
	  Support for remote processors (such as DSP coprocessors). These
	  are mainly used on embedded systems.

if REMOTEPROC

config REMOTEPROC_CDEV
	bool "Remoteproc character device interface"
	help
	  Say y here to have a character device interface for the remoteproc
	  framework. Userspace can boot/shutdown remote processors through
	  this interface.

	  It's safe to say N if you don't want to use this interface.

endif # REMOTEPROC

endmenu
```

## 6.18.52-VXTux-UMS512/drivers/rpmsg/Kconfig
```kconfig
# SPDX-License-Identifier: GPL-2.0

menu "Rpmsg drivers"

# RPMSG always gets selected by whoever wants it
config RPMSG
	tristate

config RPMSG_CHAR
	tristate "RPMSG device interface"
	depends on RPMSG
	depends on NET
	help
	  Say Y here to export rpmsg endpoints as device files, usually found
	  in /dev. They make it possible for user-space programs to send and
	  receive rpmsg packets.

config RPMSG_CTRL
	tristate "RPMSG control interface"
	depends on RPMSG && ( RPMSG_CHAR || RPMSG_CHAR=n )
	help
	  Say Y here to enable the support of the /dev/rpmsg_ctrlX API. This API
	  allows user-space programs to create endpoints with specific service name,
	  source and destination addresses.

config RPMSG_NS
	tristate "RPMSG name service announcement"
	depends on RPMSG
	help
	  Say Y here to enable the support of the name service announcement
	  channel that probes the associated RPMsg device on remote endpoint
	  service announcement.

config RPMSG_VIRTIO
	tristate "Virtio RPMSG bus driver"
	depends on HAS_DMA
	select RPMSG
	select RPMSG_NS
	select VIRTIO

endmenu
```

## 6.18.52-VXTux-UMS512/drivers/soc/sprd/Kconfig
```kconfig
# SPDX-License-Identifier: GPL-2.0
# Unisoc SoC drivers from port (GPL fork)

source "drivers/soc/sprd/usbpinmux/Kconfig"
source "drivers/soc/sprd/pmic_syscon/Kconfig"
source "drivers/soc/sprd/soc_id/Kconfig"
source "drivers/soc/sprd/hwfeature/Kconfig"
source "drivers/soc/sprd/cache_efuse/Kconfig"
source "drivers/soc/sprd/power_manager/Kconfig"
source "drivers/soc/sprd/modem/Kconfig"
```

## 6.18.52-VXTux-UMS512/drivers/soc/sprd/modem/modem_loader/Kconfig
```kconfig
config SPRD_MODEM_LOADER
	tristate "SPRD Modem Loader"
	default n
	help
	  SPRD modem loader driver. Used for modem poweron, modem image load,
	  modem memory dump, modem boot and modem reset.
	  Verified 2026-10-04 against l_modem_a on this device: the partition
	  carries an SCI1 container wrapping a MECPV1.0 directory whose entries
	  include cp-modem, modem, gdsp, ldsp, cdsp, deltanv, fixnv and runnv.

config SPRD_EXT_MODEM
	tristate "SPRD External Modem support"
	default n
	depends on SPRD_MODEM_LOADER
	help
	  This feature is used to decide whether the modem type is external.
```

## 6.18.52-VXTux-UMS512/drivers/soc/sprd/soc_id/Kconfig
```kconfig
# SPDX-License-Identifier: GPL-2.0
#
# drivers/vxtux/soc/soc_id/Kconfig — port fork GPL (sprd_soc_id.c, sprd_uid.c)

config SPRD_SOCID
	tristate "Unisoc SoC identity reader (chip/plat/impl/mft/ver) (VXTux port)"
	depends on MFD_SYSCON
	default n
	help
	  Pembaca identitas SoC dari syscon chipid (0x402e0000):
	  sprd_get_soc_id() untuk konsumen in-tree. Port dari
	  drivers/misc/sprd_soc_id.c (GPL fork Samsung T618).

config SPRD_UID
	tristate "Unisoc device UID via eFuse nvmem (VXTux port)"
	depends on NVMEM
	default n
	help
	  /dev/sprd_uid + atribut sysfs uid, dibaca dari sel efuse
	  uid_start/uid_end. Port dari drivers/misc/sprd_uid.c (GPL).
```
