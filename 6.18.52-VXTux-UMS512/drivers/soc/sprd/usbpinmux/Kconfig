## 6.18.52-VXTux-UMS512/drivers/thermal/Kconfig
```kconfig
# SPDX-License-Identifier: GPL-2.0-only
#
# Generic thermal drivers configuration
#

menuconfig THERMAL
	bool "Thermal drivers"
	help
	  Thermal drivers offer a generic mechanism for
	  thermal management. Usually it's made up of one or more thermal
	  zones and cooling devices.
	  Each thermal zone contains its own temperature, trip points,
	  and cooling devices.
	  All platforms with ACPI or Open Firmware thermal support can use
	  this driver.
	  If you want this support, you should say Y here.

if THERMAL

config THERMAL_NETLINK
	bool "Thermal netlink management"
	depends on NET
	help
	  The thermal framework has a netlink interface to do thermal
	  zones discovery, temperature readings and events such as
	  trip point crossed, cooling device update or governor
	  change. It is recommended to enable the feature.

config THERMAL_STATISTICS
	bool "Thermal state transition statistics"
	help
	  Export thermal state transition statistics information through sysfs.

	  If in doubt, say N.

config THERMAL_DEBUGFS
	bool "Thermal subsystem debug support"
	depends on DEBUG_FS
	help
	  Say Y to allow the thermal subsystem to collect diagnostic
	  information that can be accessed via debugfs.

config THERMAL_CORE_TESTING
	tristate "Thermal core testing facility"
	depends on DEBUG_FS
	help
	  Say Y to add a debugfs-based thermal core testing facility.
	  It allows test thermal zones to be created and populated
	  with trip points in order to exercise the thermal core
	  functionality in a controlled way.

config THERMAL_EMERGENCY_POWEROFF_DELAY_MS
	int "Emergency poweroff delay in milli-seconds"
	default 0
	help
	  Thermal subsystem will issue a graceful shutdown when
	  critical temperatures are reached using orderly_poweroff(). In
	  case of failure of an orderly_poweroff(), the thermal emergency
	  poweroff kicks in after a delay has elapsed and shuts down the system.
	  This config is number of milliseconds to delay before emergency
	  poweroff kicks in. Similarly to the critical trip point,
	  the delay should be carefully profiled so as to give adequate
	  time for orderly_poweroff() to finish on regular execution.
	  If set to 0 emergency poweroff will not be supported.

	  In doubt, leave as 0.

config THERMAL_HWMON
	bool
	prompt "Expose thermal sensors as hwmon device"
	depends on HWMON=y || HWMON=THERMAL
	default y
	help
	  In case a sensor is registered with the thermal
	  framework, this option will also register it
	  as a hwmon. The sensor will then have the common
	  hwmon sysfs interface.

	  Say 'Y' here if you want all thermal sensors to
	  have hwmon sysfs interface too.

config THERMAL_OF
	bool
	prompt "APIs to parse thermal data out of device tree"
	depends on OF
	default y
	help
	  This options provides helpers to add the support to
	  read and parse thermal data definitions out of the
	  device tree blob.

	  Say 'Y' here if you need to build thermal infrastructure
	  based on device tree.

choice
	prompt "Default Thermal governor"
	default THERMAL_DEFAULT_GOV_STEP_WISE
	help
	  This option sets which thermal governor shall be loaded at
	  startup. If in doubt, select 'step_wise'.

config THERMAL_DEFAULT_GOV_STEP_WISE
	bool "step_wise"
	select THERMAL_GOV_STEP_WISE
	help
	  Use the step_wise governor as default. This throttles the
	  devices one step at a time.

config THERMAL_DEFAULT_GOV_FAIR_SHARE
	bool "fair_share"
	select THERMAL_GOV_FAIR_SHARE
	help
	  Use the fair_share governor as default. This throttles the
	  devices based on their 'contribution' to a zone. The
	  contribution should be provided through platform data.

config THERMAL_DEFAULT_GOV_USER_SPACE
	bool "user_space"
	select THERMAL_GOV_USER_SPACE
	help
	  The Userspace governor allows to get trip point crossed
	  notification from the kernel via uevents. It is recommended
	  to use the netlink interface instead which gives richer
	  information about the thermal framework events.

config THERMAL_DEFAULT_GOV_POWER_ALLOCATOR
	bool "power_allocator"
	depends on THERMAL_GOV_POWER_ALLOCATOR
	help
	  Select this if you want to control temperature based on
	  system and device power allocation. This governor can only
	  operate on cooling devices that implement the power API.

config THERMAL_DEFAULT_GOV_BANG_BANG
	bool "bang_bang"
	depends on THERMAL_GOV_BANG_BANG
	help
	  Use the bang_bang governor as default. This throttles the
	  devices one step at the time, taking into account the trip
	  point hysteresis.

endchoice

config THERMAL_GOV_FAIR_SHARE
	bool "Fair-share thermal governor"
	help
	  Enable this to manage platform thermals using fair-share governor.

config THERMAL_GOV_STEP_WISE
	bool "Step_wise thermal governor"
	help
	  Enable this to manage platform thermals using a simple linear
	  governor.

config THERMAL_GOV_BANG_BANG
	bool "Bang Bang thermal governor"
	default n
	help
	  Enable this to manage platform thermals using bang bang governor.

	  Say 'Y' here if you want to use two point temperature regulation
	  used for fans without throttling.  Some fan drivers depend on this
	  governor to be enabled (e.g. acerhdf).

config THERMAL_GOV_USER_SPACE
	bool "User_space thermal governor"
	help
	  Enable this to let the user space manage the platform thermals.

config THERMAL_GOV_POWER_ALLOCATOR
	bool "Power allocator thermal governor"
	depends on ENERGY_MODEL
	help
	  Enable this to manage platform thermals by dynamically
	  allocating and limiting power to devices.

config CPU_THERMAL
	bool "Generic cpu cooling support"
	depends on THERMAL_OF
	help
	  Enable the CPU cooling features. If the system has no active
	  cooling device available, this option allows to use the CPU
	  as a cooling device.

if CPU_THERMAL

config CPU_FREQ_THERMAL
	bool "CPU frequency cooling device"
	depends on CPU_FREQ
	default y
	help
	  This implements the generic cpu cooling mechanism through frequency
	  reduction. An ACPI version of this already exists
	  (drivers/acpi/processor_thermal.c).
	  This will be useful for platforms using the generic thermal interface
	  and not the ACPI interface.

config CPU_IDLE_THERMAL
	bool "CPU idle cooling device"
	depends on IDLE_INJECT
	help
	  This implements the CPU cooling mechanism through
	  idle injection. This will throttle the CPU by injecting
	  idle cycle.
endif

config DEVFREQ_THERMAL
	bool "Generic device cooling support"
	depends on PM_DEVFREQ
	depends on PM_OPP
	help
	  This implements the generic devfreq cooling mechanism through
	  frequency reduction for devices using devfreq.

	  This will throttle the device by limiting the maximum allowed DVFS
	  frequency corresponding to the cooling level.

	  In order to use the power extensions of the cooling device,
	  devfreq should use the simple_ondemand governor.

	  If you want this support, you should say Y here.

config PCIE_THERMAL
	bool "PCIe cooling support"
	depends on PCIEPORTBUS
	help
	  This implements PCIe cooling mechanism through bandwidth reduction
	  for PCIe devices.

	  If you want this support, you should say Y here.

config THERMAL_EMULATION
	bool "Thermal emulation mode support"
	help
	  Enable this option to make a emul_temp sysfs node in thermal zone
	  directory to support temperature emulation. With emulation sysfs node,
	  user can manually input temperature and test the different trip
	  threshold behaviour for simulation purpose.

	  WARNING: Be careful while enabling this option on production systems,
	  because userland can easily disable the thermal policy by simply
	  flooding this sysfs node with low temperature values.

config THERMAL_MMIO
	tristate "Generic Thermal MMIO driver"
	depends on OF
	depends on HAS_IOMEM
	help
	  This option enables the generic thermal MMIO driver that will use
	  memory-mapped reads to get the temperature.  Any HW/System that
	  allows temperature reading by a single memory-mapped reading, be it
	  register or shared memory, is a potential candidate to work with this
	  driver.

# D3 (2026-09-30): blok GENERIC_ADC_THERMAL yang TERPOTONG di baris lama
# 255-260 dihapus. Bukti: file ini mendefinisikan simbol yang sama DUA kali
# (terverifikasi: config/menuconfig dihitung per simbol, hasilnya tepat satu
# pasangan duplikat, yaitu GENERIC_ADC_THERMAL). Blok pertama terpotong di
# tengah help string ("...which is connected to the Ge") tanpa blok help
# penutup; kconfig memperlakukannya sebagai help milik blok berikutnya dan
# simbol jadi terdaftar ganda -> "drivers/thermal/Kconfig:XXX:warning:
# symbol value 'm' redefined" lalu driver Generic-gen-vs-adc ambigu.
# Blok lengkap (baris lama 261-269, help utuh sampai "lookup table.")
# DIPERTAHANKAN. Baris di bawah tidak menambah simbol baru.
config GENERIC_ADC_THERMAL
	tristate "Generic ADC based thermal sensor"
	depends on IIO
	help
	  This enabled a thermal sysfs driver for the temperature sensor
	  which is connected to the General Purpose ADC. The ADC channel
	  is read via IIO framework and the channel information is provided
	  to this driver. This driver reports the temperature by reading ADC
	  channel and converts it to temperature based on lookup table.

config SPRD_THERMAL
	tristate "Temperature sensor on Spreadtrum SoCs"
	depends on ARCH_SPRD || COMPILE_TEST
	help
	  Support for the Spreadtrum thermal sensor driver in the Linux thermal
	  framework.

# Unisoc/VXTux vendor power+thermal drivers ported from the 5.4 GPL donors in
# work/donors_20260930/. Sourced INSIDE `if THERMAL` (same placement as
# drivers/input/Kconfig:179-191 and drivers/hid/Kconfig:1419-1431) because none
# of these symbols `select THERMAL`; the enclosing if is their only common
# dependency and giving it explicitly to each one would be noise.
#
# This line is the ONLY thing that makes the subdirectory reachable. Without it,
# drivers/thermal/Makefile's pre-existing `obj-y += sprd/` descends into a
# directory whose Kconfig was never parsed, so CONFIG_VXTUX_SPRD_GPU_COOLING,
# CONFIG_SPRD_TSENSOR_THERMAL, CONFIG_SPRD_SOC_THM and CONFIG_SPRD_CPU_COOLING
# were UNDEFINED symbols: menuconfig could not offer them and no object could be
# selected. Sprd GPU cooling (2026-09-19) has been dead for this reason since the
# day it was added; the three ports inherited the same fault.
source "drivers/thermal/sprd/Kconfig"

endif
```

## 6.18.52-VXTux-UMS512/drivers/thermal/sprd/Kconfig
```kconfig
# SPDX-License-Identifier: GPL-2.0
#
# drivers/vxtux/thermal/Kconfig — GPU power model from RE

config VXTUX_SPRD_GPU_COOLING
	tristate "Spreadtrum GPU devfreq cooling power model (RE)"
	depends on DEVFREQ_THERMAL
	help
	  Unisoc (SPRD) GPU power model for devfreq_cooling, reconstructed
	  from vendor blob sprd_gpu_cooling.ko (Android 13 / kernel 5.4.210).

	  Provides two exports identical to blob:
	    create_gpu_cooling_device()  -- called by GPU driver
	    destroy_gpu_cooling_device()
	  Model uses DT coefficients from node "sprd,mali-power-model"
	  (sprd,temp-scale / sprd,voltage-scale / sprd,core-base /
	   sprd,dynamic-core ...) and temperature from thermal zone "gpu-thmzone".

	  Bit-exact RE result (C == blob assembly) proven by
	  tools/re/re_gpu_cooling_model.py; board coefficients extracted from
	  blobs/fdt_live.dtb via tools/re/re_fdt_gpu_cooling.py.

	  This driver is ABI provider without in-tree consumer (Mali DDK that
	  calls it not in this tree). Default n.

config SPRD_TSENSOR_THERMAL
	tristate "Spreadtrum SC27xx/SC2730 PMIC temperature sensor bridge"
	depends on OF && REGMAP && MFD_SC27XX_PMIC
	help
	  Bridge the SC27xx/SC2730 PMIC on-chip temperature sensor ("tsensor",
	  base register 0x1b34 on SC2730) into the Linux thermal framework.

	  Ported from the vendor blob sc27xx_tsensor_thermal.ko (Android 13 /
	  kernel 5.4.210) via work/donors_20260930/bocchi_unisoc54. Register
	  access goes through the PMIC regmap handed down by
	  drivers/mfd/sprd-sc27xx-spi.c, the same way drivers/nvmem/
	  sc27xx-efuse.c does it.

	  TWO WARNINGS, both measured (docs/baterai_termal_bedah_20260930.md):
	    1. The driver only registers thermal zones when /chosen/bootargs
	       contains "androidboot.mode=cali". Otherwise probe returns 0 and
	       registers nothing, with a dev_warn. That is the vendor blob's own
	       behaviour, not a stub: this is a factory calibration path, not a
	       runtime thermal sensor.
	    2. The "OUT" channel (sensor id 1) interpolates a 256-entry v2t_table
	       whose first 136 entries are one flat plateau, so it is not
	       factory calibrated.

	  DTS shape required by the ported driver (OF thermal binding):
	    #thermal-sensor-cells = <0>; on the sensor node, plus a
	    thermal-zones node whose thermal-sensors = <&tsensor>;

	  Say Y if you need the SC2730 factory calibration path, otherwise say N.

config SPRD_SOC_THM
	tristate "Unisoc virtual thermal zone aggregator"
	depends on OF
	help
	  "virtual-thermal" platform driver: registers a thermal zone that
	  reports the MAXIMUM of several real thermal zones, listed by phandle
	  in the property "thmzone-cells" and resolved by node name. The zone
	  id comes from the "thm-sensor" OF alias.

	  Ported from the vendor blob sprd_soc_thm.ko (kernel 5.4.210, 3
	  functions, 960 bytes of live text) via
	  work/donors_20260930/bocchi_unisoc54. No MMIO, no interrupt, no
	  polling - a single thermal_zone_device_update() at probe.

	  Only useful together with SPRD_CPU_COOLING, whose power model is fed
	  by the aggregate. Say N if you do not use that.

config SPRD_CPU_COOLING
	tristate "Unisoc CPU cooling device with static power model"
	depends on OF && CPU_FREQ && PM_OPP
	help
	  CPU cooling device driven by a static power model (leakage plus a
	  temperature/voltage scale polynomial) rather than by cpufreq_cooling.
	  The state table is the cluster's PM OPP table; the cooling device is
	  registered with thermal_of_cooling_device_register() and consumed by
	  the power_allocator governor through get_requested_power /
	  state2power / power2state.

	  Ported from the vendor blob sprd_cpu_cooling.ko (kernel 5.4.210, 31
	  functions) via work/donors_20260930/bocchi_unisoc54. Coefficients
	  come from seventeen "sprd,*" properties on the children of the
	  /cooling-devices node, indexed by the "cooling-device" OF alias.

	  Two limitations you should know before enabling it:
	    - The blob exported cpu_isolate_funs() to receive two CPU-isolator
	      function pointers from the Unisoc hotplug driver. No such provider
	      exists in this tree, so the pointers stay NULL and the driver falls
	      back to real CPU hotplug (remove_cpu()/add_cpu()).
	    - Leakage trimming from eFuse block 15 (sprd,efuse-switch) is not
	      read: the Spreadtrum OTP reader is absent from this tree, so the
	      sprd,core-base / sprd,cluster-base values are used instead.

	  The driver hot-plugs CPUs offline to reach a cooling state, so it
	  needs a DT that actually supports CPU hotplug. Say N if unsure.
```
