## 6.18.52-VXTux-UMS512/drivers/vxtux/debug/Kconfig
```kconfig
# SPDX-License-Identifier: GPL-2.0
#
# drivers/vxtux/debug/Kconfig - boot diagnostics for UMS512 (VXTux)
#
# Note: kernel messages themselves are English only.  Any text these
# options put on the panel must stay English too, so that a boot log from
# this device reads like a boot log from any other Linux machine.

config VXTUX_LKFB
	bool "Register the bootloader framebuffer as an fbdev (console on panel)"
	depends on VXTUX_DRIVERS
	depends on FB
	depends on FRAMEBUFFER_CONSOLE
	select FB_CFB_FILLRECT
	select FB_CFB_COPYAREA
	select FB_CFB_IMAGEBLIT
	# fb_io_read/fb_io_write/fb_io_mmap come from FB_DEFAULT_IOMEM_OPS,
	# which is only built by fb_io_fops.o; without this the vmlinux link
	# fails with "undefined reference to fb_io_read" (CI 40322990302).
	select FB_IOMEM_FOPS
	help
	  Register the framebuffer the display controller already scans out
	  (lcd_base=0x9e000000, 1200x2000, RGB565) as an fbdev device, so
	  fbcon attaches to it and every console=tty0 message lands on the
	  panel.

	  Without this, console=tty0 writes to a virtual console with no
	  display: the tree has no CONFIG_FB_SIMPLE (the stock device tree
	  has no simple-framebuffer node, and LK builds its own DTB) and the
	  SPRD DRM DPU never probes, so the panel would sit on the LK splash
	  image even after the kernel has booted far.

	  The driver wipes the panel and then replays the last 200 dmesg
	  lines, so the console starts clean and shows what happened before
	  fbcon was available.

	  The framebuffer memory is reserved by the early_param
	  vxtuxfb=<phys>,... in vxtux_beacon.c.  Default n; enable it when
	  chasing boot problems.

config VXTUX_BEACON
	bool "Keep the bootloader framebuffer memory out of the buddy allocator"
	depends on PRINTK
	help
	  LK leaves the panel scanning out of two buffers (0x9d000000 and
	  0x9e000000) that the stock device tree does not reserve.  This
	  option claims them in an early_param (vxtuxfb=...), while memblock
	  can still be edited, so the buddy allocator can never hand those
	  pages to anyone else and scribble over the console.

	  This file used to also draw a debug beacon - one white box per
	  initcall level, plus a red bar on panic.  That drawing path is
	  gone: the framebuffer console and its dmesg replay replaced it, and
	  the boxes made the handover from LK to the kernel look dirty.

	  Default n; required whenever VXTUX_LKFB is enabled.

config VXTUX_INITTRACE
	bool "Paint every initcall on the bootloader framebuffer"
	depends on VXTUX_DRIVERS
	depends on VXTUX_BEACON
	depends on FONT_SUPPORT
	depends on KALLSYMS
	help
	  Diagnostic for boots that freeze before fbcon exists (artix36:
	  LK starts the kernel, then the panel stays on the LK warning text
	  forever - no panic, no reboot, no eMMC write, nothing in cache).

	  Each initcall's symbol name is drawn on the LK panel (lcd_base
	  0x9e000000, reserved by VXTUX_BEACON) BEFORE the initcall runs,
	  using the built-in VGA8x16 font through the linear map.  When the
	  boot hangs, the last line on screen IS the initcall that hung.
	  vxtux_lkfb calls vxtux_itrace_stop() when fbcon takes over the
	  panel, so the two never fight over the screen.

	  Default n; enable only while chasing a boot hang.

config VXTUX_FLIGHTREC
	bool "Record the boot log to the cache partition"
	depends on PRINTK
	depends on BLOCK
	help
	  Copy the kernel log buffer (dmesg) to the cache partition
	  (mmcblk0p49, offset 8 MiB) every ~3 seconds from a kthread, and
	  once more on panic.

	  Why: a boot that hangs before userspace leaves no trace at all -
	  the panel sits on the LK splash, there is no panic, and the cache
	  partition stays empty.  With this recorder the last initcall that
	  ran is still on disk (the command line sets initcall_debug=1) and
	  can be read by dumping the cache partition.

	  Records are marked with the magic "VXTUXFR1".  Default n; enable it
	  only when chasing boot problems, since it writes to eMMC
	  continuously.

config VXTUX_BLDB
	bool "BLDB early debug ring (/dev/bldb0, Berry Lab Foundation)"
	depends on PRINTK
	depends on MISC_DEVICES
	default n
	help
	  Berry Linux Debug Bridge: a 16 MiB static printk ring plus the
	  misc device /dev/bldb0, started from core_initcall so it captures
	  the boot from the very first message.

	  The userspace daemon bldbd relays the ring to the PC over the USB
	  gadget serial port (configfs ACM) and feeds commands back
	  (stats/clear/mark/peek32/poke32), giving a two-way debug door that
	  needs no soldering and survives as long as the kernel does.

	  peek32/poke32 only touch RAM the kernel considers valid and never
	  the kernel text or the ring itself.  See the header of
	  drivers/vxtux/debug/bldb_core.c for the full ring-0 mitigation list.

	  Original work of Berry Lab Foundation (Berry Foundation Public v1
	  - MIT, GPL-compatible); no Unisoc/Spreadtrum code involved.
```

## 6.18.52-VXTux-UMS512/drivers/vxtux/soc/Kconfig
```kconfig
# SPDX-License-Identifier: GPL-2.0
# drivers/vxtux/soc/Kconfig — driver SoC Unisoc hasil port (fork GPL)

source "drivers/vxtux/soc/usbpinmux/Kconfig"
source "drivers/vxtux/soc/pmic_syscon/Kconfig"
source "drivers/vxtux/soc/soc_id/Kconfig"
source "drivers/vxtux/soc/hwfeature/Kconfig"
source "drivers/vxtux/soc/cache_efuse/Kconfig"
source "drivers/vxtux/soc/power_manager/Kconfig"

source "drivers/vxtux/soc/modem/Kconfig"
source "drivers/vxtux/soc/time_sync/Kconfig"
source "drivers/vxtux/soc/sip_svc/Kconfig"
source "drivers/vxtux/soc/debugstat/Kconfig"
source "drivers/vxtux/soc/pdbg/Kconfig"
```

## 6.18.52-VXTux-UMS512/drivers/vxtux/soc/autotest/Kconfig
```kconfig
# SPDX-License-Identifier: GPL-2.0
config SPRD_AUTOTEST
	tristate "Spreadtrum autotest framework (core)"
	depends on ARM64
	help
	  Char device "autotest0" dalam class "autotest" (10 minor) yang
	  meneruskan ioctl ke handler terdaftar berdasarkan cmd.  Modul lain
	  mendaftar lewat sprd_autotest_register_handler(); cmd duplikat
	  ditolak dengan -EEXIST.

	  Port dari blob vendor 5.4 `core.ko`.

config SPRD_AUTOTEST_GPIO
	tristate "Spreadtrum autotest GPIO handler"
	depends on SPRD_AUTOTEST && GPIOLIB
	help
	  Handler cmd 0xc0044101 (_IOWR('A', 1, 4)): argumen u32 dari user
	  berisi offset (bit 0..15), dir (bit 16), value (bit 17).  Chip
	  dipilih dengan ngpio == 256; arah input membaca nilai line dan
	  menulis balik bit 17.

	  Port dari blob vendor 5.4 `gpio.ko`.
```

## 6.18.52-VXTux-UMS512/drivers/vxtux/soc/debugstat/Kconfig
```kconfig
# SPDX-License-Identifier: GPL-2.0
config SPRD_DEBUGSTAT
	tristate "Spreadtrum subsystem sleep statistics"
	depends on ARM64 && PROC_FS && MFD_SYSCON
	select SPRD_SIP_SVC
	help
	  Collects per-subsystem sleep counters (AP and PMIC SoC) and
	  exposes them under /proc/sprd-debugstat/. The AP numbers come
	  from the SIP power service, the SoC counter is read from the
	  PMIC register described by the soc_slp_cnt_reg device tree
	  property.

	  Port of the vendor 5.4 `sprd_power_stat.ko`.
```

## 6.18.52-VXTux-UMS512/drivers/vxtux/soc/iq/Kconfig
```kconfig
# SPDX-License-Identifier: GPL-2.0
config SPRD_IQ
	tristate "Spreadtrum IQ playback / I-Q data device"
	depends on OF
	depends on SPRD_SIPC
	depends on USB_F_VSERIAL
	help
	  Character device (/dev/iq_mem) exposing the reserved RAM region
	  shared with the protocol stack processor for I/Q playback and
	  modem data capture.

	  The region is named by the "sprd,region" phandle of the
	  "sprd,iq" device tree node and mapped through SIPC.  Data can
	  be pushed to the host over the vser USB bypass path, handed to
	  user space with mmap(), or moved by the modem straight into the
	  shared region; the mode is selected through the SET_MODE ioctl.

	  The driver only binds when the kernel command line contains
	  "androidboot.mode=iq"; on a normal boot it stays inert.

	  Port of the vendor 5.4 `sprd_iq.ko`.  Say M to build the module.
```

## 6.18.52-VXTux-UMS512/drivers/vxtux/soc/manufacturer_model/Kconfig
```kconfig
# SPDX-License-Identifier: GPL-2.0
config SPRD_MANUFACTURER_MODEL
	tristate "Spreadtrum SoC model / manufacturer strings"
	depends on OF
	help
	  Reads the "soc-module" (SoC model) and "soc-manufacturer"
	  properties from the device tree root node and exposes them as
	  the soc_model / soc_manufacturer sysfs attributes of a private
	  device, e.g. "soc_model: UMS512".

	  Port of the vendor 5.4 `sprd_manufacturer_model.ko`.  The blob
	  initialises a static struct device but never registers it, so
	  the sysfs group is not reachable; the strings are still read
	  from the device tree and printed by the driver at init time.
```

## 6.18.52-VXTux-UMS512/drivers/vxtux/soc/pdbg/Kconfig
```kconfig
# SPDX-License-Identifier: GPL-2.0
config SPRD_PDBG
	tristate "Spreadtrum power debug (wakeup / sleep logging)"
	depends on ARM64 && PROC_FS && PM
	select SPRD_SIP_SVC
	help
	  Explains why the SoC slept or woke up: matches the wakeup-source
	  irq-domain names from the debuglog device tree node against the
	  live irq descriptors, logs the active wakeup sources from a
	  kernel thread, records suspend duration from the PM notifiers and
	  pulls sleep statistics from the SIP power service
	  (pwr_get_pdbg_info, SMC 0x82000502).

	  Exports sprd_pdbg_msg_print() for other drivers and
	  /proc/sprd-pdbg/regs_info for the register snapshot.

	  Port of the vendor 5.4 `sprd_pdbg.ko`.
```

## 6.18.52-VXTux-UMS512/drivers/vxtux/soc/sip_svc/Kconfig
```kconfig
# SPDX-License-Identifier: GPL-2.0
config SPRD_SIP_SVC
	tristate "Spreadtrum SIP secure monitor service client"
	depends on ARM64
	help
	  Client for the Spreadtrum SIP services implemented by the
	  secure monitor (PERF, STORAGE, PWR, DVFS, NPU, DBG). Consumers
	  such as cpufreq and pdbg call the SMC wrappers through the
	  handle exported by this module.

	  Port of the vendor 5.4 `sprd_sip_svc.ko`.
```

## 6.18.52-VXTux-UMS512/drivers/vxtux/soc/sprd_7sreset/Kconfig
```kconfig
# SPDX-License-Identifier: GPL-2.0
config SPRD_7SRESET
	tristate "Spreadtrum PMIC 7s reset controller"
	depends on MFD_SC27XX_PMIC || COMPILE_TEST
	help
	  Exposes the PMIC long-press (7s) reset knobs as sysfs attributes
	  of the hw-reset child device:

	      module_disable, hard_mode, short_mode, keypad_mode,
	      threshold_time

	  Each attribute reads/writes the PMIC register given by the
	  second cell of the "reg" property (index 1); keypad_mode uses
	  the first cell on every PMIC except SC2731.  UMP9620 additionally
	  locks/unlocks the register through 0x23d8 (bit 15 = status).

	  Port of the vendor 5.4 `sprd_7sreset.ko`.
```

## 6.18.52-VXTux-UMS512/drivers/vxtux/sound/asoc/Kconfig
```kconfig
# SPDX-License-Identifier: GPL-2.0
#
# drivers/vxtux/sound/asoc/Kconfig — ASoC Unisoc (VXTux port, tahap B4e/B4f)
#
# Rantai RE (sym_router/cek_asoc): snd-soc-core -> card-utils -> dummy-codec
# -> vbc-v4 (+fe-dai, pcm-routing) -> codec sc2730 -> mesin kartu.
# compr-2stage-dma ditunda: jalur compress 5.4 (.compr_ops platform) hilang di
# 6.18; perlu rework dai_link compress, bukan konversi mekanis.
#
# Semua simbol bool: sound stack dibangun built-in (SOUND/SND/SND_SOC=y)
# supaya simbol snd_soc_* ada di System.map dan gate C5 bisa membuktikan link.

menuconfig VXTUX_SND_SPRD_ASOC
	bool "Unisoc ASoC utilities (VXTux port)"
	depends on SND_SOC
	default n
	help
	  Utilitas ASoC Unisoc dari fork GPL 5.4: sprd-asoc-common (regmap
	  AGCP/AON/PMU + debug), sprd-asoc-card-utils (+hook/legacy), codec
	  dummy playback, dan manajer daya audio SC27xx.
	
if VXTUX_SND_SPRD_ASOC

config VXTUX_SND_SPRD_CARD
	bool "Unisoc ASoC card utils (sprd-asoc-card-utils)"
	default n
	help
	  Menyediakan simbol yang di blob diekspor snd-soc-sprd-card.ko:
	  arch_audio_{get,set}_{aon_apb,agcp_ahb,pmu_apb,ap_apb,anlg_phy}_gpr,
	  set_agcp_ahb_offset, sprd_audio_debug_init, asoc_sprd_card_probe dll.
	
config VXTUX_SND_SPRD_DUMMY_CODEC
	bool "Unisoc ASoC dummy playback codec"
	depends on VXTUX_SND_SPRD_CARD
	default n
	help
	  Pengganti blob snd-soc-sprd-dummy-codec.ko: dummy_playback_dai,
	  sprd_dummy_playback_codec_{init,exit}.
	
config VXTUX_SND_SPRD_SC2730_POWER
	bool "Unisoc SC27xx audio power manager"
	depends on VXTUX_SND_SPRD_CARD
	default n
	help
	  Pengganti blob snd-soc-sprd-codec-sc2730-power.ko.
	
config VXTUX_SND_SPRD_VBC_V4
	tristate "Unisoc VBC v4 codec-DAI + FE-DAI + pcm-routing (vbc-v4)"
	depends on SPRD_AUDIO_MCDT && SPRD_AUDIO_SIPC
	depends on VXTUX_SND_SPRD_CARD
	default n
	select VXTUX_SND_SPRD_PCM_ROUTING
	help
	  Pengganti blob snd-soc-sprd-vbc-v4.ko + snd-soc-sprd-vbc-fe.ko:
	  vbc-dai/vbc-phy-v4/vbc-codec (4332 baris, shim API legacy->component),
	  sprd-fe-dai, dan pcm-routing (blob snd-soc-sprd-pcm-routing).
	
config VXTUX_SND_SPRD_PCM_ROUTING
	bool "Unisoc ASoC pcm-routing platform"
	depends on VXTUX_SND_SPRD_CARD
	default n
	help
	  Pengganti blob snd-soc-sprd-pcm-routing.ko: sprd_routing_pcm_driver,
	  agdsp_access_enable/disable, get_dma_data_params antar-komponen.
	
config VXTUX_SND_SPRD_DMAENGINE_PCM
	tristate "Unisoc ASoC DMA-engine platform (sprd-dmaengine-pcm)"
	depends on VXTUX_SND_SPRD_CARD
	depends on SPRD_AUDIO_MEMORY_MANAGER && SPRD_AUDIO_AGDSP_ACCESS
	default n
	help
	  Pengganti blob sprd-dmaengine-pcm.ko (5.4.210). Platform ASoC
	  component "sprd-pcm-dma" untuk i2s/tdm DMA: hw_params, trigger,
	  pointer, mmap, PM notifier, dan proc ALSA "sprd-dmaengine".
	  Modul harus tetap bernama sprd-dmaengine-pcm.ko.
	
config VXTUX_SND_SPRD_COMPR_2STAGE
	tristate "Unisoc ASoC 2-stage compress platform (sprd-compr-2stage-dma)"
	depends on VXTUX_SND_SPRD_CARD
	depends on SPRD_AUDIO_MCDT && SPRD_AUDIO_SIPC
	default n
	help
	  Pengganti blob sprd-compr-2stage-dma.ko (5.4.210). Compress
	  platform Unisoc untuk offload MP3/AAC: snd_soc_component_driver
	  dengan compress_ops (open/free/set_params/trigger/pointer/copy/ack)
	  di atas MCDT + aud IPC (AMSG_CH_MP3_OFFLOAD). Sumber sudah
	  dimodernisasi ke API component 6.18 (.compress_ops, pcm_construct).

config VXTUX_SND_SPRD_SC2730
	bool "Unisoc SC2730 audio codec + headset"
	depends on VXTUX_SND_SPRD_CARD
	depends on VXTUX_SND_SPRD_VBC_V4
	default n
	help
	  Pengganti blob snd-soc-sprd-codec-sc2730.ko: sprd-codec.c (regmap-less
	  codec, read/write ops langsung), headset deteksi jack, termasuk
	  driver mesin vbc-rxpx-codec-sc27xx (compatible "sprd,vbc-v4-codec-sc2730").
	
endif # VXTUX_SND_SPRD_ASOC
```
